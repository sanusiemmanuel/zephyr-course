## app/Kconfig
```kconfig
source "Kconfig.zephyr"

config APP_HEARTBEAT_PERIOD_MS
int "Heartbeat LED period (ms)"
default 500
range 100 2000
help
  Time in milliseconds the heartbeat LED stays in each state before
  toggling.

menuconfig APP_LED_SUBSYSTEM
bool "LED Subsystem"
default y
help
  Enable the application's LED subsystem. Disabling this hides every
  LED-related option below.

if APP_LED_SUBSYSTEM

choice APP_LED_BLINK_SLEEP_TIME
prompt "LED blink sleep time"
default APP_LED_BLINK_1S
help
  Select the LED blink interval.

config APP_LED_BLINK_250MS
bool "250ms (fastest)"

config APP_LED_BLINK_500MS
bool "500ms (fast)"

config APP_LED_BLINK_1S
bool "1s (medium)"

config APP_LED_BLINK_2S
bool "2s (slow)"

endchoice

config APP_LED_BLINK_MS
int
default 250  if APP_LED_BLINK_250MS
default 500  if APP_LED_BLINK_500MS
default 1000 if APP_LED_BLINK_1S
default 2000 if APP_LED_BLINK_2S

menuconfig APP_LED_ADVANCED
bool "Advanced LED settings"
default n
help
  Expose fine-grained LED tuning parameters.

if APP_LED_ADVANCED

config APP_LED_BRIGHTNESS
int "LED brightness (0-100)"
range 0 100
default 100

config APP_LED_FADE_DURATION
int "LED fade duration (ms)"
range 0 5000
default 500

endif # APP_LED_ADVANCED

menu "Expert settings"
visible if APP_LED_ADVANCED

config APP_LED_DEBUG
bool "Enable LED debugging"
default n

config APP_LED_CUSTOM_PATTERN
bool "Custom blink pattern"
default n

endmenu # Expert settings

endif # APP_LED_SUBSYSTEM
```
